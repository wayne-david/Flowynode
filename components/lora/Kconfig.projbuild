## components/lora/Kconfig.projbuild
```kconfig
menu "LoRa Configuration"

config LORA_SPI_HOST
    int "SPI HOST"
    default 1
    help
      0=HSPI_HOST, 1=VSPI_HOST

config LORA_CS_GPIO
    int "SPI CS GPIO"
    range 0 35
    default 5
    help
    Pin Number where the NCS pin of the LoRa module is connected to.

config LORA_RST_GPIO
    int "SPI RST GPIO"
    range 0 35
    default 14
    help
    Pin Number where the NRST pin of the LoRa module is connected to.

config LORA_MISO_GPIO
    int "SPI MISO GPIO"
    range 0 35
    default 19
    help
    Pin Number to be used as the MISO SPI signal.

config LORA_MOSI_GPIO
    int "SPI MOSI GPIO"
    range 0 35
    default 23
    help
    Pin Number to be used as the MOSI SPI signal.

config LORA_SCK_GPIO
    int "SPI SCK GPIO"
    range 0 35
    default 18
    help
    Pin Number to be used as the SCK SPI signal.

config LORA_DIO0_GPIO
    int "LORA DIO0 GPIO"
    range 0 35
    default 2
    help
    Pin Number to be used as the DIO0 Lora signal.

endmenu
```
